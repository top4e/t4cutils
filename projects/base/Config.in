## projects/base/Config.in
```kconfig
#
# For a description of the syntax of this configuration file,
# see scripts/config-language.txt.
#

choice
	prompt "Target system"
	default TARGET_NATIVE

config TARGET_NATIVE
	bool "Native PC"

endchoice

menu "VEngine framework"

source "../../modules/utils/module.config"

endmenu
comment "TODO: Application part here"
```
